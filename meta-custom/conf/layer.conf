## meta-custom/conf/layer.conf
```bitbake
# We have a conf and classes directory, add to BBPATH
BBPATH .= ":${LAYERDIR}"

# We have recipes-* directories, add to BBFILES
BBFILES += "${LAYERDIR}/recipes-*/*/*.bb \
            ${LAYERDIR}/recipes-*/*/*.bbappend"

BBFILE_COLLECTIONS += "meta-custom"
BBFILE_PATTERN_meta-custom = "^${LAYERDIR}/"
BBFILE_PRIORITY_meta-custom = "6"

LAYERDEPENDS_meta-custom = "core"
LAYERSERIES_COMPAT_meta-custom = "scarthgap"
WKS_SEARCH_PATH:append = ":${LAYERDIR}/wic"

INHERIT += "extrausers"
PI_PASSWORD_HASH = "\$1\$B8/dFCBv\$eqDT9wzdvsFBMN1maL90p1"
EXTRA_USERS_PARAMS += "\
    groupadd -g 1000 pi; \
    useradd -u 1000 -g 1000 -m -d /home/pi -p '${PI_PASSWORD_HASH}' -s /bin/sh pi; \
    usermod -U pi; \
"
```
